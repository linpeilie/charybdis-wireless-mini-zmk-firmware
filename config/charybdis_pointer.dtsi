#include <input/processors.dtsi>
#include <dt-bindings/zmk/input_transform.h>
#include <behaviors/input_gestures_accel.dtsi>

&trackball_listener {
    input-processors = <
        &pointer_accel
    >;
};