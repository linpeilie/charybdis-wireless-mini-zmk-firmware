## behavior/Kconfig
```kconfig
menu "Charybdis Trackball Acceleration"

config ZMK_BEHAVIOR_TRACKBALL_ACCEL
    bool "Enable trackball acceleration behavior"
    default y
    help
        Enables dynamic pointer speed adjustment for trackball input.

endmenu
```

## config/west.yml
```yaml
manifest:
  remotes:
    - name: zmkfirmware
      url-base: https://github.com/zmkfirmware

    - name: 280Zo
      url-base: https://github.com/280Zo

    - name: nuovotaka
      url-base: https://github.com/nuovotaka

  projects:
    - name: zmk-pointing-acceleration-alpha
      remote: nuovotaka
      revision: main
    - name: zmk
      remote: zmkfirmware
      revision: main
      import: app/west.yml
    - name: zmk-pmw3610-driver
      remote: 280Zo
      revision: main

  self:
    path: config
```
